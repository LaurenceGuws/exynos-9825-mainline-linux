## Documentation/devicetree/bindings/input/touchscreen/sec,sec-ts.yaml
```yaml
# SPDX-License-Identifier: (GPL-2.0-only OR BSD-2-Clause)
%YAML 1.2
---
$id: http://devicetree.org/schemas/input/touchscreen/sec,sec-ts.yaml#
$schema: http://devicetree.org/meta-schemas/core.yaml#

title: Samsung Electronics SEC touchscreen controller

maintainers:
  - Linux Samsung SoC <linux-samsung-soc@vger.kernel.org>

allOf:
  - $ref: touchscreen.yaml#

properties:
  compatible:
    const: sec,sec_ts

  reg:
    maxItems: 1

  interrupts:
    maxItems: 1

  reset-gpios:
    maxItems: 1

  avdd-supply: true
  dvdd-supply: true

required:
  - compatible
  - reg
  - interrupts

unevaluatedProperties: false

examples:
  - |
    #include <dt-bindings/interrupt-controller/irq.h>

    i2c {
        #address-cells = <1>;
        #size-cells = <0>;

        touchscreen@48 {
            compatible = "sec,sec_ts";
            reg = <0x48>;
            interrupt-parent = <&gpio>;
            interrupts = <0 IRQ_TYPE_LEVEL_LOW>;
            touchscreen-size-x = <4096>;
            touchscreen-size-y = <4096>;
        };
    };
...
```

## Documentation/devicetree/bindings/misc/maxim,max77705-muic.yaml
```yaml
# SPDX-License-Identifier: (GPL-2.0-only OR BSD-2-Clause)
%YAML 1.2
---
$id: http://devicetree.org/schemas/misc/maxim,max77705-muic.yaml#
$schema: http://devicetree.org/meta-schemas/core.yaml#

title: Maxim MAX77705 micro USB interface controller

maintainers:
  - Linux Samsung SoC <linux-samsung-soc@vger.kernel.org>

description:
  The MAX77705 MUIC controls the USB D+/D- analog switch through the
  MAX77705 opcode I2C interface.

properties:
  compatible:
    const: maxim,max77705-muic

  reg:
    maxItems: 1

required:
  - compatible
  - reg

additionalProperties: false

examples:
  - |
    i2c {
        #address-cells = <1>;
        #size-cells = <0>;

        muic@25 {
            compatible = "maxim,max77705-muic";
            reg = <0x25>;
        };
    };
...
```

## Documentation/devicetree/bindings/phy/samsung,exynos9825-usbdrd-phy.yaml
```yaml
# SPDX-License-Identifier: (GPL-2.0-only OR BSD-2-Clause)
%YAML 1.2
---
$id: http://devicetree.org/schemas/phy/samsung,exynos9825-usbdrd-phy.yaml#
$schema: http://devicetree.org/meta-schemas/core.yaml#

title: Samsung Exynos9825 USB DRD PHY

maintainers:
  - Linux Samsung SoC <linux-samsung-soc@vger.kernel.org>

properties:
  compatible:
    const: samsung,exynos9825-usbdrd-phy

  reg:
    maxItems: 1

  clocks:
    minItems: 8
    maxItems: 8

  samsung,pmu-syscon:
    $ref: /schemas/types.yaml#/definitions/phandle
    description: Phandle to the PMU system controller.

  '#phy-cells':
    const: 0

required:
  - compatible
  - reg
  - clocks
  - samsung,pmu-syscon
  - '#phy-cells'

additionalProperties: false

examples:
  - |
    phy@10b00000 {
        compatible = "samsung,exynos9825-usbdrd-phy";
        reg = <0x10b00000 0x200>;
        clocks = <&cmu 1>, <&cmu 2>, <&cmu 3>, <&cmu 4>,
                 <&cmu 5>, <&cmu 6>, <&cmu 7>, <&cmu 8>;
        samsung,pmu-syscon = <&pmu_system_controller>;
        #phy-cells = <0>;
    };
...
```

## Documentation/devicetree/bindings/power/samsung,exynos9820-g3d-pd.yaml
```yaml
# SPDX-License-Identifier: (GPL-2.0-only OR BSD-2-Clause)
%YAML 1.2
---
$id: http://devicetree.org/schemas/power/samsung,exynos9820-g3d-pd.yaml#
$schema: http://devicetree.org/meta-schemas/core.yaml#

title: Samsung Exynos9820 and Exynos9825 G3D power domain

maintainers:
  - Linux Samsung SoC <linux-samsung-soc@vger.kernel.org>

allOf:
  - $ref: power-domain.yaml#

properties:
  compatible:
    const: samsung,exynos9820-g3d-pd

  reg:
    maxItems: 1

  '#power-domain-cells':
    const: 0

  label:
    $ref: /schemas/types.yaml#/definitions/string

  samsung,pmu-syscon:
    $ref: /schemas/types.yaml#/definitions/phandle
    description: Phandle to the PMU system controller.

required:
  - compatible
  - reg
  - '#power-domain-cells'
  - samsung,pmu-syscon

unevaluatedProperties: false

examples:
  - |
    power-domain@18400000 {
        compatible = "samsung,exynos9820-g3d-pd";
        reg = <0x18400000 0x8000>;
        #power-domain-cells = <0>;
        samsung,pmu-syscon = <&pmu_system_controller>;
    };
...
```
